## west.yml
```yaml
manifest:
  remotes:
    - name: ncs
      url-base: https://github.com/nrfconnect
  projects:
    - name: nrf
      repo-path: sdk-nrf
      remote: ncs
      revision: 03357d46827dcea2ed76042b912221af0c587d01
      import: true
    - name: zephyr-my-boards
      url: https://github.com/fgervais/zephyr-my-boards
      revision: eee5cf04b89a8366461c758329bfcf18f5bafdf5
      path: myboards
  self:
    path: application
```
